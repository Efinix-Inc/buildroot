## configs/spinal_saxon_efinix_ruby_defconfig
```kconfig
# Compilation cache
BR2_CCACHE=y
BR2_CCACHE_DIR="$(HOME)/.buildroot-ccache-saxon_default"

# Target options
BR2_riscv=y
BR2_RISCV_32=y

# Instruction Set Extensions
BR2_riscv_custom=y
BR2_RISCV_ISA_CUSTOM_RVM=y
BR2_RISCV_ISA_CUSTOM_RVA=y
BR2_RISCV_ISA_CUSTOM_RVC=n
BR2_RISCV_ABI_ILP32=y

# GCC
BR2_GCC_VERSION_8_X=y

# System
BR2_TARGET_GENERIC_GETTY=y
BR2_TARGET_GENERIC_GETTY_PORT="hvc0"

# Filesystem
BR2_TARGET_ROOTFS_CPIO=y

# Net
#BR2_SYSTEM_DHCP="eth0"

# Linux headers
BR2_PACKAGE_HOST_LINUX_HEADERS_CUSTOM_5_0=y

# Kernel
BR2_LINUX_KERNEL=y
BR2_LINUX_KERNEL_LATEST_VERSION=n
BR2_LINUX_KERNEL_CUSTOM_VERSION=y
BR2_LINUX_KERNEL_CUSTOM_VERSION_VALUE="5.0.9"
BR2_LINUX_KERNEL_USE_CUSTOM_CONFIG=y
BR2_LINUX_KERNEL_CUSTOM_CONFIG_FILE="board/spinal/saxon_efinix_ruby/linux.config"
BR2_LINUX_KERNEL_VMLINUX=y

# Rootfs customisation
BR2_ROOTFS_OVERLAY="board/spinal/saxon_efinix_ruby/rootfs_overlay"

# U-BOOT
BR2_PACKAGE_HOST_UBOOT_TOOLS=y
BR2_TARGET_ROOTFS_CPIO_UIMAGE=y

# Flashing
BR2_PACKAGE_MTD=y
BR2_PACKAGE_MTD_FLASH_ERASE=y
BR2_PACKAGE_MTD_TESTS=y
BR2_PACKAGE_MTD_FLASH_SPEED=y
BR2_PACKAGE_MTD_FLASH_TORTURE=y

# Extra packages
BR2_PACKAGE_DHRYSTONE=y
BR2_PACKAGE_MICROPYTHON=n
BR2_PACKAGE_PYTHON=n
BR2_PACKAGE_PYTHON_SPIDEV=n
BR2_PACKAGE_SL=y
BR2_PACKAGE_HELLO=n
BR2_PACKAGE_NANO=y

BR2_PACKAGE_LMBENCH=y
BR2_PACKAGE_RAMSPEED=y
BR2_PACKAGE_STRESS_NG=y

BR2_GCC_CROSS_CXX=y
BR2_INSTALL_LIBSTDCPP=y
BR2_PACKAGE_IPERF=y
BR2_PACKAGE_IPERF3=y

BR2_PACKAGE_HTOP=y
BR2_PACKAGE_LYNX=y
BR2_PACKAGE_LINKS=y

BR2_PACKAGE_LIBATOMIC_OPS_ARCH_SUPPORTS=n
BR2_PACKAGE_LIBATOMIC_OPS=n
BR2_PACKAGE_OPENSSL=n
BR2_PACKAGE_LIBOPENSSL=n
BR2_PACKAGE_OPENSSH=n

BR2_PACKAGE_RNG_TOOLS=n
BR2_PACKAGE_HAVEGED=n

BR2_PACKAGE_DROPBEAR=y
BR2_PACKAGE_SSHPASS=y

BR2_PACKAGE_BUSYBOX_SHOW_OTHERS=n
BR2_PACKAGE_BASH=n
```
